
qcom,zte_p895u90_9070mah_batterydata {
	/* #2508526_ZTE_P895U90_9070mAh_averaged_MasterSlave_Jun20th2016*/
	qcom,max-voltage-uv = <4400000>;
	qcom,nom-batt-capacity-mah = <9070>;
	qcom,batt-id-kohm = <180>;
	qcom,battery-beta = <4050>;
	qcom,battery-type = "ZTE_BATTERY_DATA_ID_1";
	qcom,chg-rslow-comp-c1 = <2223552>;
	qcom,chg-rslow-comp-c2 = <1803943>;
	qcom,chg-rs-to-rslow = <909479>;
	qcom,chg-rslow-comp-thr = <0x99>;
	qcom,checksum = <0x333C>;
	qcom,gui-version = "PMI8950GUI - 2.0.0.16";
	qcom,fg-profile-data = [
		 DE 83 FD 7C 
		 6D 81 09 7C 
		 58 83 64 66 
		 A8 82 11 8D 
		 E2 81 3B 9A 
		 62 BC 1F C8 
		 64 17 22 88 
		 37 84 FB 83 
		 78 7E 50 83 
		 AC 69 A9 79 
		 7A 86 4D 82 
		 27 98 46 B5 
		 7E C0 5E 13 
		 98 25 F7 51 
		 14 70 71 FD 
		 AA 44 62 3D 
		 A6 43 00 00 
		 21 47 77 42 
		 1D 36 00 00 
		 00 00 00 00 
		 00 00 00 00 
		 23 70 C9 6A 
		 06 5D 7D 82 
		 48 76 D7 69 
		 A3 65 E8 79 
		 BD 75 18 6A 
		 00 74 66 AA 
		 1D F5 5B 36 
		 5E A0 71 0C 
		 28 00 FF 36 
		 F0 11 30 03 
		 00 00 00 0C 
	];
};
